## meta-mender-wandboard/conf/machine/wandboard-imx6-mender.conf
```bitbake
require conf/machine/wandboard.conf

MACHINEOVERRIDES =. "wandboard:"


MENDER_UBOOT_STORAGE_DEVICE = "0"
MENDER_STORAGE_DEVICE = "/dev/mmcblk2"

BOOTENV_SIZE = "0x20000"

MENDER_IMAGE_BOOTLOADER_FILE = "SPL_UBOOT"
MENDER_IMAGE_BOOTLOADER_BOOTSECTOR_OFFSET = "2"

SRC_URI_remove_mender-uboot = " file://0006-env-Kconfig-Add-descriptions-so-environment-options-.patch"
```
